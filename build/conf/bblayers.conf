## build/conf/bblayers.conf
```bitbake
# POKY_BBLAYERS_CONF_VERSION is increased each time build/conf/bblayers.conf
# changes incompatibly
POKY_BBLAYERS_CONF_VERSION = "2"

BBPATH = "${TOPDIR}"
BBFILES ?= ""

BBLAYERS ?= " \
  /home/kin/proj/frank/src/poky/meta \
  /home/kin/proj/frank/src/poky/meta-poky \
  /home/kin/proj/frank/src/poky/meta-yocto-bsp \
  /home/kin/proj/frank/src/meta-frank/meta-devtools \
  /home/kin/proj/frank/src/meta-frank/meta-frank \
  /home/kin/proj/frank/src/meta-frank/meta-graphics \
  /home/kin/proj/frank/src/meta-openembedded/meta-oe \
  "
```

## src/meta-frank/meta-devtools/conf/layer.conf
```bitbake
# We have a conf and classes directory, add to BBPATH
BBPATH .= ":${LAYERDIR}"

# We have recipes-* directories, add to BBFILES
BBFILES += "${LAYERDIR}/recipes-*/*/*.bb \
            ${LAYERDIR}/recipes-*/*/*.bbappend"

BBFILE_COLLECTIONS += "meta-devtools"
BBFILE_PATTERN_meta-devtools = "^${LAYERDIR}/"
BBFILE_PRIORITY_meta-devtools = "6"

LAYERDEPENDS_meta-devtools = "core"
LAYERSERIES_COMPAT_meta-devtools = "styhead walnascar"
```

## src/meta-frank/meta-frank/conf/distro/frank-dbg.conf
```bitbake
require conf/distro/frank.conf

DISTRO = "frank-dbg"

DISTRO_FEATURES:append = " \
    debuginfod \
    ptest \
"
```

## src/meta-frank/meta-frank/conf/distro/frank.conf
```bitbake
require conf/distro/poky.conf

DISTRO = "frank"
DISTRO_NAME = "${DISTRO}"
DISTRO_VERSION = "0.0.47"

INIT_MANAGER = "systemd"

INHERIT += " \
    oelint \
    create-spdx \
    cve-check \
"

DISTRO_FEATURES = " \
    acl \
    alsa \
    bluetooth \
    ipsec \
    ipv4 \
    ipv6 \
    keyboard \
    pam \
    pci \
    seccomp \
    systemd \
    usbgadget \
    usbhost \
    usrmerge \
    vfat \
    virtualization \
    wifi \
    xattr \
"
```

## src/meta-frank/meta-frank/conf/layer.conf
```bitbake
# We have a conf and classes directory, add to BBPATH
BBPATH .= ":${LAYERDIR}"

# We have recipes-* directories, add to BBFILES
BBFILES += "${LAYERDIR}/recipes-*/*/*.bb \
            ${LAYERDIR}/recipes-*/*/*.bbappend"

BBFILE_COLLECTIONS += "meta-frank"
BBFILE_PATTERN_meta-frank = "^${LAYERDIR}/"
BBFILE_PRIORITY_meta-frank = "6"

LAYERDEPENDS_meta-frank = "core"
LAYERSERIES_COMPAT_meta-frank = "scarthgap"
```

## src/meta-frank/meta-frank/wic/x86-64-usb-installer.wks
```
# short-description: Create an EFI disk image for genericx86*
# long-description: Creates a partitioned EFI disk image for genericx86* machines
part /boot --source bootimg-efi --sourceparams="loader=grub-efi" --ondisk sda --label installer-boot --active --align 1024
part / --source rootfs --ondisk sda --fstype=ext4 --label installer-rootfs --align 1024 --use-uuid

bootloader --ptable gpt --configfile="grub.cfg"
```

## src/meta-frank/meta-t490/conf/layer.conf
```bitbake
# We have a conf and classes directory, add to BBPATH
BBPATH .= ":${LAYERDIR}"

# We have recipes-* directories, add to BBFILES
BBFILES += "${LAYERDIR}/recipes-*/*/*.bb \
            ${LAYERDIR}/recipes-*/*/*.bbappend"

BBFILE_COLLECTIONS += "meta-t490"
BBFILE_PATTERN_meta-t490 = "^${LAYERDIR}/"
BBFILE_PRIORITY_meta-t490 = "6"

LAYERDEPENDS_meta-t490 = "core"
LAYERSERIES_COMPAT_meta-t490 = "styhead walnascar"
```

## src/meta-frank/meta-t490/conf/machine/t490.conf
```bitbake
require conf/machine/include/x86/tune-x86-64-v3.inc


WKS_FILE ?= "systemd-boot-t490.wks"
MACHINE_ESSENTIAL_EXTRA_RDEPENDS += "kernel-image"
# do_image_wic[depends] += "mtools-native:do_populate_sysroot dosfstools-native:do_populate_sysroot virtual/bootloader:do_deploy"
# do_image_wic[depends] += "syslinux:do_populate_sysroot syslinux-native:do_populate_sysroot mtools-native:do_populate_sysroot dosfstools-native:do_populate_sysroot"


SERIAL_CONSOLES ?= "115200;ttyS0 115200;ttyO0 115200;ttyAMA0"

TARGET_ARCH = "x86_64"

PREFERRED_PROVIDER_virtual/kernel ?= "linux-yocto"
PREFERRED_PROVIDER_virtual/bootloader = "systemd-boot"

MACHINE_FEATURES = "\
    acpi \
    alsa \
    bluetooth \
    efi \
    keyboard \
    pcbios \
    pci \
    rtc \
    screen \
    usbhost \
    vfat \
"

KERNEL_IMAGETYPE = "bzImage"

IMAGE_FSTYPES ?= "ext4 wic.gz"

# IMAGE_BOOT_FILES ?= "u-boot.${UBOOT_SUFFIX} ${SPL_BINARY} ${KERNEL_IMAGETYPE} ${DTB_FILES}"
```

## src/meta-frank/meta-t490/wic/systemd-boot-t490.wks
```
# short-description: Create an EFI disk image with systemd-boot
# long-description: Creates a partitioned EFI disk image that the user
# can directly dd to boot media. The selected bootloader is systemd-boot.

part /boot --source bootimg-efi --sourceparams="loader=systemd-boot" --ondisk nvme0n1 --label msdos --active --align 1024 --use-uuid --size 1G

part / --source rootfs --ondisk nvme0n1 --fstype=ext4 --label platform --align 1024 --use-uuid

part swap --ondisk nvme0n1 --size 4G --label swap1 --fstype=swap --use-uuid

bootloader --ptable gpt --timeout=5 --append="rootwait rootfstype=ext4 console=ttyS0,115200 console=tty0"
```
